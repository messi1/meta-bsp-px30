## conf/distro/include/graphics-card.inc
```bitbake
#PREFERRED_VERSION_libdrm = "rk"
PREFERRED_PROVIDER_virtual/kernel    = "linux-rockchip"
PREFERRED_PROVIDER_virtual/egl       = "rockchip-libmali"
PREFERRED_PROVIDER_virtual/libgles1  = "rockchip-libmali"
PREFERRED_PROVIDER_virtual/libgles2  = "rockchip-libmali"
PREFERRED_PROVIDER_virtual/libopencl = "rockchip-libmali"
LICENSE_FLAGS_WHITELIST="commercial"

# For mali gpu
DISTRO_FEATURES_append += " egl"
PREFERRED_VERSION_ffmpeg = "git"

# Remove conflicting backends.
DISTRO_FEATURES_remove = "wayland x11"
```

## conf/distro/rk-egl.conf
```bitbake
include include/base.inc
include include/graphics-card.inc

# Distribution Information
DISTRO = "rk-egl"
DISTRO_NAME = "Rockchip with egl backend"
DISTRO_VERSION = "1.0+snapshot-${DATE}"
DISTRO_CODENAME = "next"
DISTROOVERRIDES = "rockchip"

TARGET_VENDOR = "-rk"
SDK_VENDOR = "-rksdk"


DISTRO_FEATURES_append += " systemd"
VIRTUAL-RUNTIME_init_manager = "systemd"


# For QT5
IMAGE_INSTALL_append += " qtbase qtbase-examples"
PACKAGECONFIG_append_pn-qtbase += " examples"
```

## conf/layer.conf
```bitbake
# We have a conf and classes directory, add to BBPATH
BBPATH .= ":${LAYERDIR}"

# We have recipes-* directories, add to BBFILES
BBFILES += "${LAYERDIR}/recipes-*/*/*.bb ${LAYERDIR}/recipes-*/*/*.bbappend"

BBFILE_COLLECTIONS += "bsp-px30"
BBFILE_PATTERN_bsp-px30 = "^${LAYERDIR}/"
BBFILE_PRIORITY_bsp-px30 = "1"

# This should only be incremented on significant changes that will
# cause compatibility issues with other layers
LAYERVERSION_bsp-px30 = "1"

LAYERDEPENDS_bsp-px30 = "core"

LAYERSERIES_COMPAT_bsp-px30 = "warrior"
```
